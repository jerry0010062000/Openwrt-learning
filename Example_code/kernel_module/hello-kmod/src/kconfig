## Example_code/kernel_module/hello-kmod/src/kconfig
```kconfig
config HELLO_KMOD
    tristate "Test kernel driver"
    help
        This is an Kernel Driver Test
        if unsure ,delete it ,just for fun
```
